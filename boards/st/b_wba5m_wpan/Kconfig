## boards/st/b_wba5m_wpan/Kconfig
```kconfig
# Copyright (c) 2026 Protronic GmbH
# SPDX-License-Identifier: Apache-2.0

config BOARD_B_WBA5M_WPAN
	select BOARD_LATE_INIT_HOOK
```

## boards/st/b_wba5m_wpan/Kconfig.b_wba5m_wpan
```kconfig
# Copyright (c) 2026 Protronic GmbH
# SPDX-License-Identifier: Apache-2.0

config BOARD_B_WBA5M_WPAN
	select SOC_STM32WBA55XX
```

## boards/st/b_wba5m_wpan/board.yml
```yaml
board:
  name: b_wba5m_wpan
  full_name: B-WBA5M-WPAN (STM32WBA5MMG module)
  vendor: st
  socs:
    - name: stm32wba55xx
```

## boards/st/stm32wba55g_dk1/Kconfig
```kconfig
# Copyright (c) 2026 Protronic GmbH
# SPDX-License-Identifier: Apache-2.0

config BOARD_STM32WBA55G_DK1
	select BOARD_LATE_INIT_HOOK
```

## boards/st/stm32wba55g_dk1/board.yml
```yaml
board:
  name: stm32wba55g_dk1
  full_name: STM32WBA55G-DK1 Discovery Kit
  vendor: st
  socs:
    - name: stm32wba55xx
```
